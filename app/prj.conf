## Kconfig
```
# Copyright (c) The Libre Solar Project Contributors
# SPDX-License-Identifier: Apache-2.0

mainmenu "Libre Solar Battery Management System Firmware"

menu "Battery default settings"

config BAT_CAPACITY_AH
    int "Battery nominal capacity in mAh"
    range 10 1000000
    default 50000
    help
      Nominal battery capacity or sum of parallel cells capacity

choice
    prompt "Default cell type"
    default CELL_TYPE_LFP
    help
      Select the type of the single cells inside the battery
      to determine voltage set points. Total voltage set points
      are multiplied with the selected number of cells.

      The default values based on this configuration can be overriden via ThingSet.

    config CELL_TYPE_LFP
        bool "LiFePO4, 3.3V nominal"

    config CELL_TYPE_NMC
        bool "NMC/Graphite, 3.7V nominal, 4.2V max"

    config CELL_TYPE_LTO
        bool "NMC/Titanate, 2.4 V nominal"

endchoice

# values must match enum CellType in bms.h
config CELL_TYPE
    int
    default 0 if CELL_TYPE_LFP
    default 1 if CELL_TYPE_NMC
    default 2 if CELL_TYPE_LTO

endmenu

# include main Zephyr menu entries from Zephyr root directory
source "Kconfig.zephyr"
```

## prj.conf
```kconfig
# SPDX-License-Identifier: Apache-2.0

CONFIG_PICOLIBC_IO_FLOAT=y

CONFIG_THREAD_NAME=y

CONFIG_REBOOT=y

CONFIG_EVENTS=y
CONFIG_HWINFO=y

CONFIG_SMF=y
CONFIG_SMF_ANCESTOR_SUPPORT=y
CONFIG_SMF_INITIAL_TRANSITION=y

CONFIG_LOG=y
CONFIG_LOG_MODE_MINIMAL=y

CONFIG_I2C=y
CONFIG_BMS_IC=y

# Enable ThingSet library and comms interfaces
CONFIG_THINGSET=y
CONFIG_THINGSET_SDK=y
CONFIG_THINGSET_SERIAL=y
CONFIG_THINGSET_STORAGE=y
CONFIG_THINGSET_STORAGE_DATA_VERSION=2
CONFIG_THINGSET_NODE_NAME="Libre Solar BMS"

# Uncomment to disable live data publication at startup
#CONFIG_THINGSET_REPORTING_LIVE_ENABLE_PRESET=n

# Change default battery nominal capacity (in mAh)
CONFIG_BAT_CAPACITY_AH=5200

# Select cell type for initial configuration: LFP (default), NMC or LTO
CONFIG_CELL_TYPE_NMC=y
```

## boards/bms_c1.conf
```kconfig
# Copyright (c) The Libre Solar Project Contributors
# SPDX-License-Identifier: Apache-2.0

# CAN
CONFIG_CAN=y
CONFIG_ISOTP=y
CONFIG_ISOTP_FAST=y
CONFIG_ENTROPY_GENERATOR=y

CONFIG_THINGSET_CAN=y

# Flash
CONFIG_MPU_ALLOW_FLASH_WRITE=y
CONFIG_FLASH=y
CONFIG_NVS=y
CONFIG_NVS_LOG_LEVEL_WRN=y

# Bluetooth
CONFIG_BT=y
CONFIG_BT_PERIPHERAL=y
CONFIG_BT_DEVICE_NAME="LibreSolar BMS-C1"
CONFIG_BT_DEVICE_NAME_DYNAMIC=y
CONFIG_BT_GATT_CLIENT=y

# Increase buffer sizes to allow long ATT values
CONFIG_BT_BUF_ACL_RX_SIZE=251
CONFIG_BT_BUF_ACL_TX_SIZE=251
CONFIG_BT_BUF_ACL_TX_COUNT=12
CONFIG_BT_BUF_EVT_RX_COUNT=16
CONFIG_BT_L2CAP_TX_MTU=251

CONFIG_THINGSET_BLE=y

CONFIG_SHELL=y
# Avoid conflicts with ThingSet ? command
CONFIG_SHELL_WILDCARD=n
# Support `select thingset` to run ThingSet requests directly
CONFIG_SHELL_CMDS_SELECT=y

CONFIG_THINGSET_SHELL=y
CONFIG_THINGSET_SHELL_REPORTING=n
CONFIG_THINGSET_SHELL_CMD_BUF_SIZE=256

# WS2812 LED strip (SPI backend)
CONFIG_SPI=y
CONFIG_LED_STRIP=y
```

## src/main.c
```c
/*
 * Copyright (c) The Libre Solar Project Contributors
 *
 * SPDX-License-Identifier: Apache-2.0
 */

#include <zephyr/device.h>
#include <zephyr/kernel.h>

#include <stdio.h>

#include "button.h"
#include "data_objects.h"
#include "helper.h"
#include "leds.h"
#include "thingset.h"
#include <bms/bms.h>

LOG_MODULE_REGISTER(bms_main, CONFIG_LOG_DEFAULT_LEVEL);

struct bms_context bms = {
    .ic_dev = DEVICE_DT_GET(DT_ALIAS(bms_ic)),
};

int main(void)
{
    int err;

    LOG_INF("Hardware: Libre Solar %s (%s)", DT_PROP(DT_PATH(pcb), type),
            DT_PROP(DT_PATH(pcb), version_str));
    LOG_INF("Firmware: %s", FIRMWARE_VERSION_ID);

    if (!device_is_ready(bms.ic_dev)) {
        LOG_ERR("BMS IC not ready");
        return -ENODEV;
    }

    bms_ic_assign_data(bms.ic_dev, &bms.ic_data);

    err = bms_ic_set_mode(bms.ic_dev, BMS_IC_MODE_ACTIVE);
    if (err != 0) {
        LOG_ERR("Failed to activate BMS IC: %d", err);
    }

    err = bms_ic_configure(bms.ic_dev, &bms.ic_conf, BMS_IC_CONF_ALL);
    if (err < 0) {
        LOG_ERR("Failed to configure BMS IC: %d", err);
    }

    err = bms_ic_read_data(bms.ic_dev, BMS_IC_DATA_CELL_VOLTAGES);
    if (err != 0) {
        LOG_ERR("Failed to read data from BMS IC: %d", err);
    }

    bms_soc_reset(&bms, -1);

    button_init();

    int64_t t_start = k_uptime_get();
    while (true) {
        err = bms_ic_read_data(bms.ic_dev, BMS_IC_DATA_ALL);
        if (err != 0) {
            LOG_ERR("Failed to read data from BMS IC: %d", err);
        }
        bms.error_flags |= bms.ic_data.error_flags;

        bms_soc_update(&bms);

        t_start += CONFIG_BMS_IC_POLLING_INTERVAL_MS;
        k_sleep(K_TIMEOUT_ABS_MS(t_start));
    }

    return 0;
}

static int init_config(void)
{
    bms_init_config(&bms, (enum bms_cell_type)CONFIG_CELL_TYPE, CONFIG_BAT_CAPACITY_AH / 1000.0F);

    return 0;
}

/*
 * The default configuration must be initialized before the ThingSet storage backend reads data
 * from EEPROM or flash (with THINGSET_INIT_PRIORITY_STORAGE = 40).
 */
SYS_INIT(init_config, APPLICATION, 0);
```

## src/bms_common.c
```c
/*
 * Copyright (c) The Libre Solar Project Contributors
 *
 * SPDX-License-Identifier: Apache-2.0
 */

#include <bms/bms.h>
#include <bms/bms_common.h>

#include "helper.h"

#include <stdio.h>

LOG_MODULE_REGISTER(bms, CONFIG_LOG_DEFAULT_LEVEL);

static const float ocv_lfp[NUM_OCV_POINTS] = {
    3.392F, 3.314F, 3.309F, 3.308F, 3.304F, 3.296F, 3.283F, 3.275F, 3.271F, 3.268F, 3.265F,
    3.264F, 3.262F, 3.252F, 3.240F, 3.226F, 3.213F, 3.190F, 3.177F, 3.132F, 2.833F,
};

static const float ocv_nmc[NUM_OCV_POINTS] = {
    4.198F, 4.135F, 4.089F, 4.056F, 4.026F, 3.993F, 3.962F, 3.924F, 3.883F, 3.858F, 3.838F,
    3.819F, 3.803F, 3.787F, 3.764F, 3.745F, 3.726F, 3.702F, 3.684F, 3.588F, 2.800F,
};

// Source: DOI:10.3390/batteries5010031 (https://www.mdpi.com/2313-0105/5/1/31)
static const float ocv_lto[NUM_OCV_POINTS] = {
    2.800F, 2.513F, 2.458F, 2.415F, 2.376F, 2.340F, 2.309F, 2.282F, 2.259F, 2.240F, 2.224F,
    2.210F, 2.198F, 2.187F, 2.177F, 2.166F, 2.154F, 2.141F, 2.125F, 2.105F, 2.000F,
};

static const float soc_default[NUM_OCV_POINTS] = {
    100.0F, 95.0F, 90.0F, 85.0F, 80.0F, 75.0F, 70.0F, 65.0F, 60.0F, 55.0F, 50.0F,
    45.0F,  40.0F, 35.0F, 30.0F, 25.0F, 20.0F, 15.0F, 10.0F, 5.0F,  0.0F,
};

// actually used OCV vs. SOC curve
float ocv_points[NUM_OCV_POINTS] = { 0 };
float soc_points[NUM_OCV_POINTS] = { 0 };

void bms_init_config(struct bms_context *bms, enum bms_cell_type type, float nominal_capacity_Ah)
{
    bms->nominal_capacity_Ah = nominal_capacity_Ah;

    bms->chg_enable = true;
    bms->dis_enable = false;

    bms->ic_conf.auto_balancing = true;
    bms->ic_conf.bal_idle_delay = 1800;         // default: 30 minutes
    bms->ic_conf.bal_idle_current = 0.1F;       // A
    bms->ic_conf.bal_cell_voltage_diff = 0.01F; // 10 mV

#ifdef CONFIG_BMS_IC_CURRENT_MONITORING
    /* 1C should be safe for all batteries */
    bms->ic_conf.dis_oc_limit = bms->nominal_capacity_Ah;
    bms->ic_conf.chg_oc_limit = bms->nominal_capacity_Ah;

    bms->ic_conf.dis_oc_delay_ms = 320;
    bms->ic_conf.chg_oc_delay_ms = 320;

    bms->ic_conf.dis_sc_limit = bms->ic_conf.dis_oc_limit * 2;
    bms->ic_conf.dis_sc_delay_us = 200;
#endif /* CONFIG_BMS_IC_CURRENT_MONITORING */

    bms->ic_conf.dis_ut_limit = -20;
    bms->ic_conf.dis_ot_limit = 45;
    bms->ic_conf.chg_ut_limit = 0;
    bms->ic_conf.chg_ot_limit = 45;
    bms->ic_conf.temp_limit_hyst = 5;

    bms->ic_conf.cell_ov_delay_ms = 2000;
    bms->ic_conf.cell_uv_delay_ms = 2000;

    bms->ocv_points = ocv_points;
    bms->soc_points = soc_points;

    memcpy(soc_points, soc_default, sizeof(soc_points));

    switch (type) {
        case CELL_TYPE_LFP:
            bms->ic_conf.cell_ov_limit = 3.80F;
            bms->ic_conf.cell_chg_voltage_limit = 3.55F;
            bms->ic_conf.cell_ov_reset = 3.40F;
            bms->ic_conf.bal_cell_voltage_min = 3.30F;
            bms->ic_conf.cell_uv_reset = 3.10F;
            bms->ic_conf.cell_dis_voltage_limit = 2.80F;
            /*
             * most cells survive even 2.0V, but we should keep some margin for further
             * self-discharge
             */
            bms->ic_conf.cell_uv_limit = 2.50F;
            memcpy(ocv_points, ocv_lfp, sizeof(ocv_points));
            break;
        case CELL_TYPE_NMC:
            bms->ic_conf.cell_ov_limit = 4.25F;
            bms->ic_conf.cell_chg_voltage_limit = 4.20F;
            bms->ic_conf.cell_ov_reset = 4.05F;
            bms->ic_conf.bal_cell_voltage_min = 3.80F;
            bms->ic_conf.cell_uv_reset = 3.50F;
            bms->ic_conf.cell_dis_voltage_limit = 3.20F;
            bms->ic_conf.cell_uv_limit = 3.00F;
            memcpy(ocv_points, ocv_nmc, sizeof(ocv_points));
            break;
        case CELL_TYPE_LTO:
            bms->ic_conf.cell_ov_limit = 2.85F;
            bms->ic_conf.cell_chg_voltage_limit = 2.80F;
            bms->ic_conf.cell_ov_reset = 2.70F;
            bms->ic_conf.bal_cell_voltage_min = 2.50F;
            bms->ic_conf.cell_uv_reset = 2.10F;
            bms->ic_conf.cell_dis_voltage_limit = 2.00F;
            bms->ic_conf.cell_uv_limit = 1.90F;
            memcpy(ocv_points, ocv_lto, sizeof(ocv_points));
            break;
    }

    /* trigger alert for all possible errors by default */
    bms->ic_conf.alert_mask = BMS_ERR_ALL;
}

bool bms_chg_error(uint32_t error_flags)
{
    return error_flags
           & (BMS_ERR_CELL_OVERVOLTAGE | BMS_ERR_CHG_OVERCURRENT | BMS_ERR_OPEN_WIRE
              | BMS_ERR_CHG_UNDERTEMP | BMS_ERR_CHG_OVERTEMP | BMS_ERR_INT_OVERTEMP
              | BMS_ERR_CELL_FAILURE | BMS_ERR_CHG_OFF);
}

bool bms_dis_error(uint32_t error_flags)
{
    return error_flags
           & (BMS_ERR_CELL_UNDERVOLTAGE | BMS_ERR_SHORT_CIRCUIT | BMS_ERR_DIS_OVERCURRENT
              | BMS_ERR_OPEN_WIRE | BMS_ERR_DIS_UNDERTEMP | BMS_ERR_DIS_OVERTEMP
              | BMS_ERR_INT_OVERTEMP | BMS_ERR_CELL_FAILURE | BMS_ERR_DIS_OFF);
}

bool bms_chg_allowed(struct bms_context *bms)
{
    return !bms_chg_error(bms->ic_data.error_flags & ~BMS_ERR_CHG_OFF) && !bms->full
           && bms->chg_enable;
}

bool bms_dis_allowed(struct bms_context *bms)
{
    return !bms_dis_error(bms->ic_data.error_flags & ~BMS_ERR_DIS_OFF) && !bms->empty
           && bms->dis_enable;
}
```

## src/bms_state_machine.c
```c
#include <zephyr/kernel.h>
#include <zephyr/logging/log.h>
#include <zephyr/smf.h>

#include <bms/bms.h>
#include <bms/bms_common.h>

#include "bms_state_machine.h"
#include "button.h"

LOG_MODULE_REGISTER(bms_sm, CONFIG_LOG_DEFAULT_LEVEL);

/* List of events */
struct k_event sm_events; /* Shared with button.c */

/* Forward declaration of state table */
static const struct smf_state smf_state_table[];

/* Charger/charge detection thresholds */
#define CHARGER_V_THRESHOLD 0.5f /* V above total_voltage to detect charger */
#define CHARGE_I_DETECT     0.3f /* A: current threshold to detect active charging */
#define CHARGE_I_CUTOFF     0.1f /* A: current below which charge is considered complete */
#define CELL_V_BALANCE_MARGIN \
    0.05f                       /* V: margin below cell_chg_voltage_limit to trigger balance \
                                 */
#define CHARGER_ABSENT_CYCLES 5 /* Poll cycles (~2.5s) to confirm charger removal */
#define CHARGER_DETECT_CYCLES 6 /* Poll cycles (3s) to confirm charger/current detection */
#define BALANCE_TIMEOUT_MS    (10 * 60 * 1000)

/* User defined object */
struct bms_sm_obj
{
    struct smf_ctx ctx; /* Must be first member */
    int64_t start_time;
    struct bms_context *bms;
    uint32_t events;
    uint8_t detect_count; /* Shared debounce counter for detection logic */
} sm_obj;

/* State change event — posted when SM leaf state changes */
struct k_event sm_state_events;

/*
 * Hardware error check — called at start of parent run handlers.
 * Returns true if error detected (transition to SM_ERROR already requested).
 */
static inline bool check_hw_error(struct bms_sm_obj *o)
{
    if (o->bms->error_flags != 0) {
        smf_set_state(SMF_CTX(o), &smf_state_table[SM_ERROR]);
        return true;
    }
    return false;
}

/* ── SM_STANDBY (L1 parent: user OFF) ───────────────────────── */

static void standby_entry(void *obj)
{
    struct bms_sm_obj *o = (struct bms_sm_obj *)obj;
    o->bms->dis_enable = false;
    // o->bms->chg_enable = false;
    LOG_INF("Entered STANDBY");
}

static enum smf_state_result standby_run(void *obj)
{
    struct bms_sm_obj *o = (struct bms_sm_obj *)obj;

    if (check_hw_error(o)) {
        return SMF_EVENT_HANDLED;
    }

    /* Button press → SOC display (only propagated from SM_OFF) */
    if (o->events & BTN_EVT_PRESS) {
        smf_set_state(SMF_CTX(o), &smf_state_table[SM_SOC]);
        return SMF_EVENT_HANDLED;
    }

    if (o->bms->dis_enable && o->bms->chg_enable) {
        smf_set_state(SMF_CTX(o), &smf_state_table[SM_NORMAL]);
        return SMF_EVENT_HANDLED;
    }

    return SMF_EVENT_HANDLED;
}

/* ── SM_OFF (STANDBY child, initial: all FETs off) ──────────── */

static void off_entry(void *obj)
{
    struct bms_sm_obj *o = (struct bms_sm_obj *)obj;
    bms_ic_set_switches(o->bms->ic_dev, 0);
    o->detect_count = 0;
    o->bms->state = BMS_STATE_OFF;
    LOG_INF("Entered OFF");
}

static enum smf_state_result off_run(void *obj)
{
    struct bms_sm_obj *o = (struct bms_sm_obj *)obj;
    struct bms_context *bms = o->bms;
    float ext_v = bms->ic_data.external_voltage;
    float total_v = bms->ic_data.total_voltage;
    float pack_ov = bms->ic_conf.cell_ov_limit * bms->ic_data.connected_cells;

    if (ext_v > pack_ov) {
        // TODO: ws2812 warning
        LOG_WRN("External OV: %.2fV (limit %.2fV)", (double)ext_v, (double)pack_ov);
    }
    else if (ext_v > total_v + CHARGER_V_THRESHOLD) {
        o->detect_count++;
        if (o->detect_count >= CHARGER_DETECT_CYCLES && o->bms->chg_enable == true) {
            smf_set_state(SMF_CTX(o), &smf_state_table[SM_CHARGE]);
            return SMF_EVENT_HANDLED;
        }
    }
    else {
        o->detect_count = 0;
    }

    /* Propagate button events to STANDBY parent */
    return SMF_EVENT_PROPAGATE;
}

/* ── SM_SOC (STANDBY child: SOC display) ─────────────────────── */

static void soc_entry(void *obj)
{
    struct bms_sm_obj *o = (struct bms_sm_obj *)obj;
    o->start_time = k_uptime_get();
    LOG_INF("Entered SOC");
}

static enum smf_state_result soc_run(void *obj)
{
    struct bms_sm_obj *o = (struct bms_sm_obj *)obj;

    if (o->events & BTN_EVT_PRESS) {
        smf_set_state(SMF_CTX(o), &smf_state_table[SM_OPEN]);
    }
    else if (o->events & BTN_EVT_RELEASE) {
        o->start_time = k_uptime_get();
    }
    else if (k_uptime_get() - o->start_time > 3000) {
        smf_set_state(SMF_CTX(o), &smf_state_table[SM_OFF]);
    }

    return SMF_EVENT_HANDLED;
}

/* ── SM_OPEN (STANDBY child: button held, pending power-on) ─── */

static void open_entry(void *obj)
{
    struct bms_sm_obj *o = (struct bms_sm_obj *)obj;
    o->start_time = k_uptime_get();
    LOG_INF("Entered OPEN");
}

static enum smf_state_result open_run(void *obj)
{
    struct bms_sm_obj *o = (struct bms_sm_obj *)obj;
    int64_t elapsed = k_uptime_get() - o->start_time;

    if (elapsed <= 750 && (o->events & BTN_EVT_RELEASE)) {
        smf_set_state(SMF_CTX(o), &smf_state_table[SM_SOC]);
    }
    else if (elapsed > 1250) {
        if (o->bms->chg_enable) {
            smf_set_state(SMF_CTX(o), &smf_state_table[SM_NORMAL]);
        }
        else {
            smf_set_state(SMF_CTX(o), &smf_state_table[SM_SOC]);
        }
    }

    return SMF_EVENT_HANDLED;
}

/* ── SM_ON (L1 parent: user ON, all FETs enabled) ───────────── */

static void on_entry(void *obj)
{
    struct bms_sm_obj *o = (struct bms_sm_obj *)obj;
    o->bms->dis_enable = true;
    // o->bms->chg_enable = true;
    LOG_INF("Entered ON");
}

static enum smf_state_result on_run(void *obj)
{
    struct bms_sm_obj *o = (struct bms_sm_obj *)obj;

    if (check_hw_error(o)) {
        return SMF_EVENT_HANDLED;
    }

    if (!(o->bms->dis_enable && o->bms->chg_enable)) {
        smf_set_state(SMF_CTX(o), &smf_state_table[SM_OFF]);
        return SMF_EVENT_HANDLED;
    }

    if (o->events & BTN_EVT_PRESS) {
        smf_set_state(SMF_CTX(o), &smf_state_table[SM_C1]);
        return SMF_EVENT_HANDLED;
    }

    return SMF_EVENT_HANDLED;
}

/* ── SM_NORMAL (ON child, initial: all FETs on) ─────────────── */

static void normal_entry(void *obj)
{
    struct bms_sm_obj *o = (struct bms_sm_obj *)obj;
    bms_ic_set_switches(o->bms->ic_dev,
                        BMS_SWITCH_CHG | BMS_SWITCH_PCHG | BMS_SWITCH_DIS | BMS_SWITCH_PDSG);
    o->detect_count = 0;
    o->bms->state = BMS_STATE_NORMAL;
    LOG_INF("Entered NORMAL");
}

static enum smf_state_result normal_run(void *obj)
{
    struct bms_sm_obj *o = (struct bms_sm_obj *)obj;
    /* Detect charging activity → start charging session */
    if (o->bms->ic_data.current > CHARGE_I_DETECT) {
        o->detect_count++;
        if (o->detect_count >= CHARGER_DETECT_CYCLES) {
            smf_set_state(SMF_CTX(o), &smf_state_table[SM_CHARGE]);
            return SMF_EVENT_HANDLED;
        }
    }
    else {
        o->detect_count = 0;
    }

    /* Propagate button events and hw_error check to ON parent */
    return SMF_EVENT_PROPAGATE;
}

/* ── SM_C1 (ON child: shutdown confirm step 1) ──────────────── */

static void c1_entry(void *obj)
{
    struct bms_sm_obj *o = (struct bms_sm_obj *)obj;
    o->start_time = k_uptime_get();
    LOG_INF("Entered C1");
}

static enum smf_state_result c1_run(void *obj)
{
    struct bms_sm_obj *o = (struct bms_sm_obj *)obj;

    if (o->events & BTN_EVT_PRESS) {
        smf_set_state(SMF_CTX(o), &smf_state_table[SM_C2]);
    }
    else if (o->events & BTN_EVT_RELEASE) {
        o->start_time = k_uptime_get();
    }
    else if (k_uptime_get() - o->start_time > 3000) {
        smf_set_state(SMF_CTX(o), &smf_state_table[SM_NORMAL]);
    }

    return SMF_EVENT_HANDLED;
}

/* ── SM_C2 (ON child: shutdown confirm step 2) ──────────────── */

static void c2_entry(void *obj)
{
    struct bms_sm_obj *o = (struct bms_sm_obj *)obj;
    o->start_time = k_uptime_get();
    LOG_INF("Entered C2");
}

static enum smf_state_result c2_run(void *obj)
{
    struct bms_sm_obj *o = (struct bms_sm_obj *)obj;
    int64_t elapsed = k_uptime_get() - o->start_time;

    if (elapsed <= 750 && (o->events & BTN_EVT_RELEASE)) {
        smf_set_state(SMF_CTX(o), &smf_state_table[SM_C1]);
    }
    else if (elapsed > 1250) {
        smf_set_state(SMF_CTX(o), &smf_state_table[SM_OFF]);
    }

    return SMF_EVENT_HANDLED;
}

/* ── SM_CHARGING (L1 parent: charging session) ──────────────── */

static void charging_entry(void *obj)
{
    struct bms_sm_obj *o = (struct bms_sm_obj *)obj;
    o->detect_count = 0;

    // o->bms->chg_enable = true;
    // o->bms->dis_enable = true;
    LOG_INF("Entered CHARGING");
}

static enum smf_state_result charging_run(void *obj)
{
    struct bms_sm_obj *o = (struct bms_sm_obj *)obj;

    if (check_hw_error(o)) {
        return SMF_EVENT_HANDLED;
    }

    if (!o->bms->chg_enable) {
        smf_set_state(SMF_CTX(o), &smf_state_table[SM_OFF]);
        return SMF_EVENT_HANDLED;
    }

    /* Charger removal detection with debounce */
    if (o->bms->ic_data.external_voltage > o->bms->ic_data.total_voltage + CHARGER_V_THRESHOLD
        || o->bms->ic_data.current > CHARGE_I_DETECT)
    {
        o->detect_count = 0;
    }
    else {
        o->detect_count++;
        if (o->detect_count >= CHARGER_ABSENT_CYCLES) {
            LOG_INF("Charger removed, exiting charging session");
            if (SMF_CTX(o)->previous == &smf_state_table[SM_NORMAL]) {
                smf_set_state(SMF_CTX(o), &smf_state_table[SM_NORMAL]);
            }
            else {
                smf_set_state(SMF_CTX(o), &smf_state_table[SM_OFF]);
            }
            return SMF_EVENT_HANDLED;
        }
    }

    /* Consume all button events during charging */
    if (o->events & BTN_EVT_ALL) {
        return SMF_EVENT_HANDLED;
    }

    return SMF_EVENT_HANDLED;
}

/* ── SM_CHARGE (CHARGING child, initial: all FETs on) ────────── */

static void charge_entry(void *obj)
{
    struct bms_sm_obj *o = (struct bms_sm_obj *)obj;
    bms_ic_set_switches(o->bms->ic_dev,
                        BMS_SWITCH_CHG | BMS_SWITCH_PCHG | BMS_SWITCH_DIS | BMS_SWITCH_PDSG);
    o->bms->state = BMS_STATE_NORMAL;
    LOG_INF("Entered CHARGE");
}

static enum smf_state_result charge_run(void *obj)
{
    struct bms_sm_obj *o = (struct bms_sm_obj *)obj;
    struct bms_context *bms = o->bms;
    float cell_v_max = bms->ic_data.cell_voltage_max;
    float cell_chg_limit = bms->ic_conf.cell_chg_voltage_limit;
    float cell_v_diff = cell_v_max - bms->ic_data.cell_voltage_min;

    /* Full detection: any cell reached limit or charge current tapered off */
    if (cell_v_max >= cell_chg_limit) {
        LOG_INF("Charge complete: cell_voltage_max %.3fV >= limit %.3fV", (double)cell_v_max,
                (double)cell_chg_limit);
        bms->full = true;
        smf_set_state(SMF_CTX(o), &smf_state_table[SM_OFF]);
        return SMF_EVENT_HANDLED;
    }

    if (cell_v_max > (cell_chg_limit - CELL_V_BALANCE_MARGIN)
        && bms->ic_data.current < CHARGE_I_CUTOFF)
    {
        LOG_INF("Charge complete: current %.3fA < cutoff, cell_max %.3fV",
                (double)bms->ic_data.current, (double)cell_v_max);
        bms->full = true;
        smf_set_state(SMF_CTX(o), &smf_state_table[SM_OFF]);
        return SMF_EVENT_HANDLED;
    }

    /* Balance needed: cell approaching limit with voltage imbalance */
    if (cell_v_max > (cell_chg_limit - CELL_V_BALANCE_MARGIN)
        && cell_v_diff > bms->ic_conf.bal_cell_voltage_diff + 0.02f)
    {
        LOG_INF("Balance needed: cell_max %.3fV, diff %.3fV", (double)cell_v_max,
                (double)cell_v_diff);
        smf_set_state(SMF_CTX(o), &smf_state_table[SM_BALANCE]);
        return SMF_EVENT_HANDLED;
    }

    /* Propagate to SM_CHARGING parent for hw_error, charger removal, button handling */
    return SMF_EVENT_PROPAGATE;
}

/* ── SM_BALANCE (CHARGING child: CHG off for balancing) ──────── */

static void balance_entry(void *obj)
{
    struct bms_sm_obj *o = (struct bms_sm_obj *)obj;
    bms_ic_set_switches(o->bms->ic_dev, 0);
    o->start_time = k_uptime_get();
    o->bms->state = BMS_STATE_OFF;
    LOG_INF("Entered BALANCE");
}

static enum smf_state_result balance_run(void *obj)
{
    struct bms_sm_obj *o = (struct bms_sm_obj *)obj;
    struct bms_context *bms = o->bms;
    float cell_v_diff = bms->ic_data.cell_voltage_max - bms->ic_data.cell_voltage_min;

    /* Cells balanced enough or voltage relaxed — resume charging */
    if (cell_v_diff <= bms->ic_conf.bal_cell_voltage_diff) {
        LOG_INF("Balance complete: diff %.3fV <= threshold %.3fV", (double)cell_v_diff,
                (double)bms->ic_conf.bal_cell_voltage_diff);
        smf_set_state(SMF_CTX(o), &smf_state_table[SM_CHARGE]);
        return SMF_EVENT_HANDLED;
    }

    if (k_uptime_get() - o->start_time > BALANCE_TIMEOUT_MS) {
        LOG_INF("Balance timeout, resuming charge");
        smf_set_state(SMF_CTX(o), &smf_state_table[SM_CHARGE]);
        return SMF_EVENT_HANDLED;
    }

    /* Propagate to SM_CHARGING parent for hw_error, charger removal, button handling */
    return SMF_EVENT_PROPAGATE;
}

/* ── SM_SHUTDOWN (L1 leaf: shutdown sequence) ────────────────── */

static void shutdown_entry(void *obj)
{
    struct bms_sm_obj *o = (struct bms_sm_obj *)obj;
    bms_ic_set_switches(o->bms->ic_dev, 0);
    o->bms->dis_enable = false;
    o->bms->chg_enable = false;
    o->bms->state = BMS_STATE_SHUTDOWN;
    LOG_INF("Entered SHUTDOWN");
}

static enum smf_state_result shutdown_run(void *obj)
{
    struct bms_sm_obj *o = (struct bms_sm_obj *)obj;
    bms_ic_set_mode(o->bms->ic_dev, BMS_IC_MODE_OFF);
    return SMF_EVENT_HANDLED;
}

/* ── SM_ERROR (L1 leaf: hardware error, all FETs off) ────────── */

static void err_entry(void *obj)
{
    struct bms_sm_obj *o = (struct bms_sm_obj *)obj;
    bms_ic_set_switches(o->bms->ic_dev, 0);
    o->bms->dis_enable = false;
    o->bms->chg_enable = false;
    LOG_ERR("Entered ERROR, flags: 0x%08x", o->bms->error_flags);
}

static enum smf_state_result err_run(void *obj)
{
    struct bms_sm_obj *o = (struct bms_sm_obj *)obj;

    if (o->bms->ic_data.error_flags == 0 && (o->events & BTN_EVT_LONG_PRESS_5S)) {
        o->bms->error_flags = 0;
        o->bms->chg_enable = true;
        smf_set_state(SMF_CTX(o), &smf_state_table[SM_OFF]);
        LOG_INF("Exiting ERROR: flags cleared + long press");
    }

    return SMF_EVENT_HANDLED;
}

/* ── State table ─────────────────────────────────────────────── */

static const struct smf_state smf_state_table[SM_STATE_COUNT] = {
    /* L1 parents */
    [SM_STANDBY] =
        SMF_CREATE_STATE(standby_entry, standby_run, NULL, NULL, &smf_state_table[SM_OFF]),
    [SM_ON] = SMF_CREATE_STATE(on_entry, on_run, NULL, NULL, &smf_state_table[SM_NORMAL]),
    [SM_CHARGING] =
        SMF_CREATE_STATE(charging_entry, charging_run, NULL, NULL, &smf_state_table[SM_CHARGE]),

    /* STANDBY children */
    [SM_OFF] = SMF_CREATE_STATE(off_entry, off_run, NULL, &smf_state_table[SM_STANDBY], NULL),
    [SM_SOC] = SMF_CREATE_STATE(soc_entry, soc_run, NULL, &smf_state_table[SM_STANDBY], NULL),
    [SM_OPEN] = SMF_CREATE_STATE(open_entry, open_run, NULL, &smf_state_table[SM_STANDBY], NULL),

    /* ON children */
    [SM_NORMAL] = SMF_CREATE_STATE(normal_entry, normal_run, NULL, &smf_state_table[SM_ON], NULL),
    [SM_C1] = SMF_CREATE_STATE(c1_entry, c1_run, NULL, &smf_state_table[SM_ON], NULL),
    [SM_C2] = SMF_CREATE_STATE(c2_entry, c2_run, NULL, &smf_state_table[SM_ON], NULL),

    /* CHARGING children */
    [SM_CHARGE] =
        SMF_CREATE_STATE(charge_entry, charge_run, NULL, &smf_state_table[SM_CHARGING], NULL),
    [SM_BALANCE] =
        SMF_CREATE_STATE(balance_entry, balance_run, NULL, &smf_state_table[SM_CHARGING], NULL),

    /* L1 leaf states */
    [SM_SHUTDOWN] = SMF_CREATE_STATE(shutdown_entry, shutdown_run, NULL, NULL, NULL),
    [SM_ERROR] = SMF_CREATE_STATE(err_entry, err_run, NULL, NULL, NULL),
};

/* ── State machine thread ────────────────────────────────────── */

static void bms_sm_thread(void *p1, void *p2, void *p3)
{
    sm_obj.bms = (struct bms_context *)p1;

    k_event_init(&sm_events);

    k_event_init(&sm_state_events);

    smf_set_initial(SMF_CTX(&sm_obj), &smf_state_table[SM_STANDBY]);

    LOG_INF("BMS state machine started");

    while (true) {
        uint32_t evt = k_event_wait(&sm_events, BTN_EVT_ALL, true, K_MSEC(500));
        sm_obj.events = evt;

        const struct smf_state *prev = sm_obj.ctx.current;
        int ret = smf_run_state(SMF_CTX(&sm_obj));
        if (ret) {
            LOG_ERR("State machine terminated: %d", ret);
            break;
        }
        if (sm_obj.ctx.current != prev) {
            uint8_t state = (uint8_t)(sm_obj.ctx.current - smf_state_table);
            // DEBUG
            // LOG_INF("SM: set event BIT(%d) now", state);
            k_event_set(&sm_state_events, BIT(state));
            // LOG_INF("SM: set event BIT(%d) done", state);
        }
    }
}

extern struct bms_context bms;
K_THREAD_DEFINE(bms_sm_tid, 1024, bms_sm_thread, &bms, NULL, NULL, 5, 0, 0);
```

## src/bms_state_machine.h
```c
/*
 * Copyright (c) The Libre Solar Project Contributors
 *
 * SPDX-License-Identifier: Apache-2.0
 */

#ifndef BMS_STATE_MACHINE_H_
#define BMS_STATE_MACHINE_H_

#include <zephyr/kernel.h>

#include <stdint.h>

/**
 * Hierarchical State Machine with independent charging session
 *
 * SM_STANDBY (parent: user OFF)
 *   ├── SM_OFF     (initial: all FETs off)
 *   ├── SM_SOC     (SOC display on button press)
 *   └── SM_OPEN    (button held, pending power-on)
 *
 * SM_ON (parent: user ON)
 *   ├── SM_NORMAL  (initial: all FETs on)
 *   ├── SM_C1      (shutdown confirm step 1)
 *   └── SM_C2      (shutdown confirm step 2)
 *
 * SM_CHARGING (parent: charging session)
 *   ├── SM_CHARGE  (initial: all FETs on, actively charging)
 *   └── SM_BALANCE (DIS+PDSG only, CHG off for balancing)
 *
 * SM_SHUTDOWN (leaf: shutdown sequence)
 * SM_ERROR    (leaf: hardware error, all FETs off)
 */
/**
 * State machine leaf states (maps 1:1 to SMF state table indices).
 */
enum sm_state
{
    SM_STANDBY,
    SM_OFF,
    SM_SOC,
    SM_OPEN,
    SM_ON,
    SM_NORMAL,
    SM_C1,
    SM_C2,
    SM_CHARGING,
    SM_CHARGE,
    SM_BALANCE,
    SM_SHUTDOWN,
    SM_ERROR,
    SM_STATE_COUNT,
};

/**
 * @brief State machine state change events
 * 
 * Each state transition sets the corresponding bit (BIT(state)).
 * Subscribers can extract the state using: state = __builtin_ffs(events) - 1
 * 
 * Bit mapping:
 *   BIT(0)  = SM_STANDBY
 *   BIT(1)  = SM_OFF
 *   BIT(2)  = SM_SOC
 *   BIT(3)  = SM_OPEN
 *   BIT(4)  = SM_ON
 *   BIT(5)  = SM_NORMAL
 *   BIT(6)  = SM_C1
 *   BIT(7)  = SM_C2
 *   BIT(8)  = SM_CHARGING
 *   BIT(9)  = SM_CHARGE
 *   BIT(10) = SM_BALANCE
 *   BIT(11) = SM_SHUTDOWN
 *   BIT(12) = SM_ERROR
 */
extern struct k_event sm_state_events;

#endif /* BMS_STATE_MACHINE_H_ */
```

## src/button.c
```c
/*
 * Copyright (c) The Libre Solar Project Contributors
 *
 * SPDX-License-Identifier: Apache-2.0
 */

#include "button.h"

#include <zephyr/device.h>
#include <zephyr/drivers/gpio.h>
#include <zephyr/kernel.h>

#include "helper.h"

LOG_MODULE_REGISTER(button, CONFIG_LOG_DEFAULT_LEVEL);

#define BTN_GPIO  DT_ALIAS(sw_pwr)
#define BTN_CTLR  DT_GPIO_CTLR(BTN_GPIO, gpios)
#define BTN_PIN   DT_GPIO_PIN(BTN_GPIO, gpios)
#define BTN_FLAGS DT_GPIO_FLAGS(BTN_GPIO, gpios)

static const struct device *btn_dev = DEVICE_DT_GET(BTN_CTLR);
static struct gpio_callback btn_cb_data;

/* Forward declaration - defined in bms_state_machine.c */
extern struct k_event sm_events;

static struct k_work_delayable debounce_work;
static struct k_work_delayable long_press_work;

static void debounce_handler(struct k_work *work)
{
    int pin_state = gpio_pin_get(btn_dev, BTN_PIN);

    if (pin_state == 1) {
        /* Button pressed (active) */
        k_event_post(&sm_events, BTN_EVT_PRESS);
        /* Start long press timer (5 seconds) */
        k_work_schedule(&long_press_work, K_MSEC(5000));
        LOG_INF("Button pressed");
    } else {
        /* Button released */
        k_event_post(&sm_events, BTN_EVT_RELEASE);
        /* Cancel long press timer */
        k_work_cancel_delayable(&long_press_work);
        LOG_INF("Button released");
    }
}

static void long_press_handler(struct k_work *work)
{
    /* Verify button is still held down */
    if (gpio_pin_get(btn_dev, BTN_PIN) == 1) {
        k_event_post(&sm_events, BTN_EVT_LONG_PRESS_5S);
        LOG_INF("Button long pressed (5s)");
    }
}

static void gpio_cb(const struct device *dev, struct gpio_callback *cb, uint32_t pins)
{
    /* Reschedule debounce work at 20ms */
    k_work_reschedule(&debounce_work, K_MSEC(20));
}

void button_init(void)
{
    if (!device_is_ready(btn_dev)) {
        LOG_ERR("Button device not found");
        return;
    }

    /* Initialize work items */
    k_work_init_delayable(&debounce_work, debounce_handler);
    k_work_init_delayable(&long_press_work, long_press_handler);

    /* Configure GPIO */
    gpio_pin_configure(btn_dev, BTN_PIN, BTN_FLAGS | GPIO_INPUT);
    gpio_pin_interrupt_configure(btn_dev, BTN_PIN, GPIO_INT_EDGE_BOTH);

    /* Setup callback */
    gpio_init_callback(&btn_cb_data, gpio_cb, BIT(BTN_PIN));
    gpio_add_callback(btn_dev, &btn_cb_data);

    LOG_INF("Button initialized");
}
```

## src/button.h
```c
/*
 * Copyright (c) The Libre Solar Project Contributors
 *
 * SPDX-License-Identifier: Apache-2.0
 */

#ifndef BUTTON_H_
#define BUTTON_H_

#include <zephyr/kernel.h>

#ifdef __cplusplus
extern "C" {
#endif

/**
 * @file
 * @brief Button event system for power switch
 *
 * Button events are posted to the state machine event object (sm_events)
 * via k_event_post(). The SM thread consumes them with k_event_wait().
 */

/** Button event bit flags */
#define BTN_EVT_PRESS         BIT(0)
#define BTN_EVT_RELEASE       BIT(1)
#define BTN_EVT_LONG_PRESS_5S BIT(2)
#define BTN_EVT_ALL           (BTN_EVT_PRESS | BTN_EVT_RELEASE | BTN_EVT_LONG_PRESS_5S)

/**
 * Initialize button GPIO, interrupts, debounce, and long-press detection.
 *
 * Must be called after the SM event object (sm_events) is initialized.
 */
void button_init(void);

#ifdef __cplusplus
}
#endif

#endif /* BUTTON_H_ */
```

## src/ws2812_led.c
```c
/*
 * Copyright (c) The Libre Solar Project Contributors
 *
 * SPDX-License-Identifier: Apache-2.0
 */

#include <zephyr/drivers/led_strip.h>
#include <zephyr/kernel.h>
#include <zephyr/logging/log.h>

#include <bms/bms.h>

#include "bms_state_machine.h"

#include <math.h>

LOG_MODULE_REGISTER(ws2812, CONFIG_LOG_DEFAULT_LEVEL);

#define STRIP_NODE     DT_CHOSEN(zephyr_led_strip)
#define NUM_LEDS       DT_PROP(STRIP_NODE, chain_length)
#define TICK_MS        50
#define TICKS_250MS    5   /* 250ms / 50ms */
#define TICKS_500MS    10  /* 500ms / 50ms */
#define TICKS_3S       60  /* 3s / 50ms */
#define MAX_BRIGHTNESS 128

static const struct device *strip = DEVICE_DT_GET(STRIP_NODE);
static struct led_rgb pixels[NUM_LEDS];

extern struct bms_context bms;

/* ── Color helpers ───────────────────────────────────────────── */

static inline struct led_rgb rgb_white(uint8_t brightness)
{
    return (struct led_rgb){ .r = brightness, .g = brightness, .b = brightness };
}

static inline struct led_rgb rgb_green(uint8_t brightness)
{
    return (struct led_rgb){ .r = 0, .g = brightness, .b = 0 };
}

static inline struct led_rgb rgb_red(uint8_t brightness)
{
    return (struct led_rgb){ .r = brightness, .g = 0, .b = 0 };
}

static inline struct led_rgb rgb_off(void)
{
    return (struct led_rgb){ .r = 0, .g = 0, .b = 0 };
}

/* ── Animation: OFF / SHUTDOWN (all dark) ────────────────────── */

static void anim_off(void)
{
    for (int i = 0; i < NUM_LEDS; i++) {
        pixels[i] = rgb_off();
    }
}

/* ── Animation: SOC display (SM_SOC / SM_NORMAL) ─────────────── */

/*
 * SOC level table: each entry defines how many LEDs are solid (A)
 * and which LED blinks (B). Levels map to 12.5% steps.
 *
 * Level 0: =0%       → all off
 * Level 1: 0-12.5%   → LED1=B
 * Level 2: 12.5-25%  → LED1=A
 * Level 3: 25-37.5%  → LED1=A, LED2=B
 * Level 4: 37.5-50%  → LED1-2=A
 * Level 5: 50-62.5%  → LED1-2=A, LED3=B
 * Level 6: 62.5-75%  → LED1-3=A
 * Level 7: 75-87.5%  → LED1-3=A, LED4=B
 * Level 8: 87.5-100% → LED1-4=A
 */
static void anim_soc(uint32_t tick)
{
    float soc = bms.soc;
    int level;

    if (soc <= 0.0f) {
        level = 0;
    }
    else if (soc >= 87.5f) {
        level = 8;
    }
    else {
        level = 1 + (int)(soc / 12.5f);
    }

    int solid = level / 2;       /* Number of solid-on LEDs */
    bool has_blink = (level % 2); /* Is there a blinking LED? */
    int blink_idx = solid;        /* Index of blinking LED (if any) */

    /* Blink phase: 250ms on, 250ms off, starting dark */
    bool blink_on = has_blink && ((tick / TICKS_250MS) % 2 == 1);

    for (int i = 0; i < NUM_LEDS; i++) {
        if (i < solid) {
            pixels[i] = rgb_white(MAX_BRIGHTNESS);
        }
        else if (i == blink_idx && blink_on) {
            pixels[i] = rgb_white(MAX_BRIGHTNESS);
        }
        else {
            pixels[i] = rgb_off();
        }
    }
}

/* ── Animation: OPEN (sequential light-up) ───────────────────── */

static void anim_open(uint32_t tick)
{
    /* Frame index: 0=dark, 1=LED1, 2=LED1-2, 3=LED1-3, 4=all */
    int frame = tick / TICKS_250MS;

    for (int i = 0; i < NUM_LEDS; i++) {
        pixels[i] = (i < frame) ? rgb_white(MAX_BRIGHTNESS) : rgb_off();
    }
}

/* ── Animation: C1 (all flash) ───────────────────────────────── */

static void anim_c1(uint32_t tick)
{
    bool on = ((tick / TICKS_250MS) % 2 == 0);
    struct led_rgb color = on ? rgb_white(MAX_BRIGHTNESS) : rgb_off();

    for (int i = 0; i < NUM_LEDS; i++) {
        pixels[i] = color;
    }
}

/* ── Animation: C2 (sequential turn-off) ─────────────────────── */

static void anim_c2(uint32_t tick)
{
    /* Frame: 0=all on, 1=3 on, 2=2 on, 3=1 on, 4=all off */
    int frame = tick / TICKS_250MS;
    int lit = NUM_LEDS - frame;

    for (int i = 0; i < NUM_LEDS; i++) {
        pixels[i] = (i < lit) ? rgb_white(MAX_BRIGHTNESS) : rgb_off();
    }
}

/* ── Animation: CHARGE (cycling charge) ──────────────────────── */

static void anim_charge(uint32_t tick)
{
    float soc = bms.soc;

    // if (bms.full) {
    //     anim_off();
    //     return;
    // }

    /* Number of LEDs in the animation range */
    int range;
    if (soc < 25.0f) {
        range = 1;
    }
    else if (soc < 50.0f) {
        range = 2;
    }
    else if (soc < 75.0f) {
        range = 3;
    }
    else {
        range = 4;
    }

    /*
     * Cycle: frame 0 = all dark, frame 1 = LED1 on, ..., frame N = LED1..N on
     * Total frames = range + 1 (including the dark frame)
     */
    int frame = (tick / TICKS_250MS) % (range + 1);

    for (int i = 0; i < NUM_LEDS; i++) {
        if (i < frame) {
            pixels[i] = rgb_green(MAX_BRIGHTNESS);
        }
        else {
            pixels[i] = rgb_off();
        }
    }
}

/* ── Animation: BALANCE (green gradient ping-pong) ───────────── */

static void anim_balance(uint32_t tick)
{
    /*
     * Ping-pong: position moves 0→3→0 over 6 segments.
     * Each segment takes ~20 ticks (1 second), full cycle ~6 seconds.
     */
    #define BALANCE_SEGMENT_TICKS 20
    #define BALANCE_CYCLE_TICKS   (BALANCE_SEGMENT_TICKS * 6)

    int cycle_tick = tick % BALANCE_CYCLE_TICKS;
    /* Triangle wave: 0→3→0 */
    float pos;
    if (cycle_tick < BALANCE_SEGMENT_TICKS * 3) {
        pos = (float)cycle_tick / BALANCE_SEGMENT_TICKS;
    }
    else {
        pos = 6.0f - (float)cycle_tick / BALANCE_SEGMENT_TICKS;
    }

    for (int i = 0; i < NUM_LEDS; i++) {
        float dist = fabsf((float)i - pos);
        int brightness = (int)(MAX_BRIGHTNESS * (1.0f - dist / 1.5f));
        if (brightness < 0) {
            brightness = 0;
        }
        pixels[i] = rgb_green((uint8_t)brightness);
    }
}

/* ── Animation: ERROR (binary error code) ────────────────────── */

static void anim_error(uint32_t tick)
{
    uint32_t flags = bms.error_flags;

    if (flags == 0) {
        anim_off();
        return;
    }

    /* Count active errors and find the one to display */
    int error_count = 0;
    int error_numbers[15];

    for (int bit = 0; bit < 15; bit++) {
        if (flags & BIT(bit)) {
            error_numbers[error_count++] = bit + 1; /* 1-indexed */
        }
    }

    /* Rotate through errors every 3 seconds */
    int idx = (tick / TICKS_3S) % error_count;
    int error_num = error_numbers[idx];

    /* Blink: on/off 250ms */
    bool on = ((tick / TICKS_250MS) % 2 == 0);

    for (int i = 0; i < NUM_LEDS; i++) {
        if (on && (error_num & BIT(i))) {
            pixels[i] = rgb_red(MAX_BRIGHTNESS);
        }
        else {
            pixels[i] = rgb_off();
        }
    }
}

/* ── WS2812 thread ───────────────────────────────────────────── */

static void ws2812_thread(void *p1, void *p2, void *p3)
{
    if (!device_is_ready(strip)) {
        LOG_ERR("LED strip device not ready");
        return;
    }

    LOG_INF("WS2812 LED strip initialized (%d LEDs)", NUM_LEDS);

    uint8_t prev_state = SM_STATE_COUNT; /* Invalid initial value to force reset */
    uint32_t tick = 0;

    while (true) {
        uint32_t events = k_event_wait(&sm_state_events, 0xFFFFFFFF, false, K_MSEC(TICK_MS));
        if (events) {
            k_event_clear(&sm_state_events, events);
        }
        // DEBUG
        // LOG_INF("WS: events=0x%04x state=%d prev=%d", events, events ? (__builtin_ffs(events) - 1) : prev_state, prev_state);

        uint8_t state = events ? (__builtin_ffs(events) - 1) : prev_state;

        if (state != prev_state) {
            tick = 0;
            prev_state = state;
        }

        switch (state) {
        case SM_OFF:
        case SM_SHUTDOWN:
        case SM_STANDBY:
            anim_off();
            break;
        case SM_SOC:
        case SM_NORMAL:
            anim_soc(tick);
            break;
        case SM_OPEN:
            anim_open(tick);
            break;
        case SM_C1:
            anim_c1(tick);
            break;
        case SM_C2:
            anim_c2(tick);
            break;
        case SM_CHARGE:
            anim_charge(tick);
            break;
        case SM_BALANCE:
            anim_balance(tick);
            break;
        case SM_ERROR:
            anim_error(tick);
            break;
        default:
            anim_off();
            break;
        }

        led_strip_update_rgb(strip, pixels, NUM_LEDS);
        tick++;
    }
}

K_THREAD_DEFINE(ws2812_tid, 1024, ws2812_thread, NULL, NULL, NULL, 6, 0, 0);
```
